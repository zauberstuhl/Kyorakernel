## kernel/drivers/amlogic/display/vout/Kconfig
```kconfig
#
# Video output configuration
#
menu "Amlogic video output module"

config AM_TV_OUTPUT
	tristate "TV output"
	default y
	help  
		tv output module
		
config AM_TCON_OUTPUT
	tristate "LCD output" 
	help  
		LCD output module

config AML_TCON_T13
	tristate "T13 panel driver"
	depends on  AM_TCON_OUTPUT
	help  
		T13 LCD panel module

config AML_TCON_ML10
	tristate "ML10 panel driver"
	depends on  AM_TCON_OUTPUT
	help  
		ML10 LCD panel module

config AML_TCON_W10
	tristate "W10 panel driver"
	depends on  AM_TCON_OUTPUT
	help  
		W10 LCD panel module

config AML_TCON_W7
	tristate "W7 panel driver"
	depends on  AM_TCON_OUTPUT
	help  
		W7 LCD panel module

config AML_TCON_W8
	tristate "W8 panel driver"
	depends on  AM_TCON_OUTPUT
	help  
		W8 LCD panel module

config AML_TCON_P7
	tristate "P7 panel driver"
	depends on  AM_TCON_OUTPUT
	help  
		P7 LCD panel module

config AML_TCON_K7
	tristate "K7 panel driver"
	depends on  AM_TCON_OUTPUT
	help  
		K7 LCD panel module

config AML_TCON_K7New
	tristate "K7New panel driver"
	depends on  AM_TCON_OUTPUT
	help  
		K7New LCD panel module
				
config AML_TCON_C7
	tristate "C7 panel driver"
	depends on  AM_TCON_OUTPUT
	help  
		C7 LCD panel module	
		
config AML_TCON_K8
	tristate "K8 panel driver"
	depends on  AM_TCON_OUTPUT
	help  
		K8 LCD panel module
		
config AML_TCON_G7
	tristate "G7 panel driver"
	depends on  AM_TCON_OUTPUT
	help  
		G7 LCD panel module		
		
config AML_TCON_R10
	tristate "R10 panel driver"
	depends on  AM_TCON_OUTPUT
	help  
		R10 LCD panel module

config AML_TCON_REFB13
	tristate "REFB13 panel driver"
	depends on  AM_TCON_OUTPUT
	help  
		REFB13 LCD panel module	
endmenu
	
```

## kernel/drivers/amlogic/nand/Kconfig
```kconfig
#
# Sensor device configuration
#

menu "AMLOGIC NAND Flash  support"

config AM_NAND
	bool "Amlogic NAND FLASH SUPPORT"
	    depends on ARCH_MESON
	default y
        select MTD_NAND 
	    select MTD_PARTITIONS
        select MTD_BLOCK
        select MTD_CHAR
        help
		This is Meson_M1 nand suport

config AML_NFTL
	bool "Amlogic NFTL SUPPORT"
	depends on AM_NAND
	default n
        help
		This is aml nftl suport
endmenu
```

## kernel/drivers/amlogic/wifi/Kconfig
```kconfig
menu "Amlogic WIFI Support"

config SDIO_DHD_CDC_WIFI_4319
	bool "Broadcom 4319 wireless cards support"
	depends on SD_MMC
	select WIRELESS_EXT
	select WEXT_PRIV
	---help---
	  This module adds support for wireless adapters based on
	  Broadcom 4319 chipset.

	  This driver uses the kernel's wireless extensions subsystem.
	  You should add bcm4329 firmware and nvram file in directory drivers/amlogic/wifi/
	  
          & assure to set these config in 
	  Device Drivers  ---> Generic Driver Options  ---> 

	  [*]   Include in-kernel firmware blobs in kernel binary  
          (broadcm_4319/nvram_4319_201008.txt broadcm_4319/sdio-g-cdc-full11n-reclaim-roml-wme.bin) External firmware blobs to build into 
	  
config BCM4319_FW_PATH
	depends on SDIO_DHD_CDC_WIFI_4319
	string "BCM4319 Firmware path"
	default "broadcm_4319/sdio-g-cdc-full11n-reclaim-roml-wme.bin"
	---help---
	  Path to the firmware file.

config BCM4319_NVRAM_PATH
	depends on SDIO_DHD_CDC_WIFI_4319
	string "BCM4319 NVRAM path"
	default "broadcm_4319/nvram_4319_201008.txt"
	---help---
	  Path to nvram file.

config SDIO_DHD_CDC_WIFI_4329
	bool "Broadcom 4329 wireless cards support"
	depends on SD_MMC
	select WIRELESS_EXT
	select WEXT_PRIV
	---help---
	  This module adds support for wireless adapters based on
	  Broadcom 4329 chipset.

	  This driver uses the kernel's wireless extensions subsystem.
	  You should add bcm4329 firmware and nvram file in directory drivers/amlogic/wifi/
	  
          & assure to set these config in 
	  Device Drivers  ---> Generic Driver Options  ---> 

	  [*]   Include in-kernel firmware blobs in kernel binary  
          (broadcm_4329/nvram.txt broadcm_4329/sdio-g-cdc-full11n-reclaim-roml-wme-idsup.bin) External firmware blobs to build into 
	  
config BCM4329_FW_PATH
	depends on SDIO_DHD_CDC_WIFI_4329
	string "BCM4329 Firmware path"
	default "broadcm_4329/sdio-g-cdc-full11n-reclaim-roml-wme-idsup.bin"
	---help---
	  Path to the firmware file.

config BCM4329_NVRAM_PATH
	depends on SDIO_DHD_CDC_WIFI_4329
	string "BCM4329 NVRAM path"
	default "broadcm_4329/nvram.txt"
	---help---
	  Path to nvram file.

config RTL8712_8188_8191_8192SU_USB_WIFI
	tristate "Realtek 8712 8188 8191 8192SU Wireless USB Dongle support"
	default n
	depends on MAC80211 && USB
	---help---
	  This module adds support for wireless USB dongle based on
	  Realtek 8712 8188 8191 8192SU chipset.

config RTL8192CU_USB_WIFI
	tristate "Realtek 8192CU Wireless USB Dongle support"
	default n
	depends on MAC80211 && USB
	---help---
	  This module adds support for wireless USB dongle based on
	  Realtek 8192CU chipset.

config SDIO_ATHEROS_6302_WIFI
	bool "ATHEROS 6302 wireless cards support"
	depends on SD_MMC
	select WIRELESS_EXT
	select WEXT_PRIV
	---help---
	This module adds support for ATHEROS 6302 wireless cards support.
	
	This driver uses the kernel's wireless extensions subsystem.
	You should add ATHEROS 6302 firmware file in directory firmware/atheros_6302
	
	    & assure to set these config in 
	Device Drivers  ---> Generic Driver Options  ---> 
	
	[*]   Include in-kernel firmware blobs in kernel binary  
	    (atheros_6302/otp.bin.z77 atheros_6302/athwlan.bin.z77 atheros_6302/data.patch.bin atheros_6302/bdata.SD31.bin) External firmware blobs to build into 

config AR6003_REV2_OTP_FILE
	depends on SDIO_ATHEROS_6302_WIFI
	string "ATHEROS_6302 OTP path"
	default "atheros_6302/otp.bin.z77"
	---help---
	  Path to the otp file.
	  
config AR6003_REV2_FIRMWARE_FILE
	depends on SDIO_ATHEROS_6302_WIFI
	string "ATHEROS_6302 FIRMWARE path"
	default "atheros_6302/athwlan.bin.z77"
	---help---
	  Path to the firmware file.
	  
config AR6003_REV2_PATCH_FILE
	depends on SDIO_ATHEROS_6302_WIFI
	string "ATHEROS_6302 PATCH path"
	default "atheros_6302/data.patch.bin"
	---help---
	  Path to the patch file.

config AR6003_REV2_BOARD_DATA_FILE
	depends on SDIO_ATHEROS_6302_WIFI
	string "ATHEROS_6302 BOARD_DATA path"
	default "atheros_6302/bdata.SD31.bin"
	---help---
	  Path to the bdata file.
	  
config SDIO_ATHEROS_6102_WIFI
	bool "ATHEROS 6102 wireless cards support"
	depends on SD_MMC
	select WIRELESS_EXT
	select WEXT_PRIV
	---help---
	This module adds support for ATHEROS 6102 wireless cards support.
	
	This driver uses the kernel's wireless extensions subsystem.
	You should add ATHEROS 6102 firmware file in directory firmware/atheros_6102
	
	    & assure to set these config in 
	Device Drivers  ---> Generic Driver Options  ---> 
	
	[*]   Include in-kernel firmware blobs in kernel binary  
	    (atheros_6102/calData_ar6102_15dBm.bin atheros_6102/athwlan.bin.z77 atheros_6102/data.patch.hw2_0.bin) External firmware blobs to build into 	  
	  	  	  
config AR6102_FIRMWARE_FILE
	depends on SDIO_ATHEROS_6102_WIFI
	string "ATHEROS_6102 FIRMWARE path"
	default "atheros_6102/athwlan.bin.z77"
	---help---
	  Path to the firmware file.
	  
config AR6102_PATCH_FILE
	depends on SDIO_ATHEROS_6102_WIFI
	string "ATHEROS_6102 PATCH path"
	default "atheros_6102/data.patch.hw2_0.bin"
	---help---
	  Path to the patch file.

config AR6102_BOARD_DATA_FILE
	depends on SDIO_ATHEROS_6102_WIFI
	string "ATHEROS_6102 BOARD_DATA path"
	default "atheros_6102/calData_ar6102_15dBm.bin"
	---help---
	  Path to the bdata file.
	  
menuconfig SDIO_MARVELL_NH387_WIFI
	bool "Marvell nh387 wireless cards support"
	depends on SD_MMC
	select WIRELESS_EXT
	select WEXT_PRIV
	---help---
	  This module adds support for wireless adapters based on
	  Marvell nh387 chipset.

	  This driver uses the kernel's wireless extensions subsystem.
	  You should add Marvell nh387 firmware and nvram file in directory drivers/amlogic/wifi/
	  
          & assure to set these config in 
	  Device Drivers  ---> Generic Driver Options  ---> 

	  [*]   Include in-kernel firmware blobs in kernel binary  
          (mrvl/sd8787_uapsta.bin mrvl/sd8787_uapsta_w1.bin) External firmware blobs to build into 
if SDIO_MARVELL_NH387_WIFI	  
config SDIO_HARD_IRQ
	depends on SDIO
	bool "SDIO HARD IRQ"
	default y
	---help---
	  hard irq wake up polling process
config MRVLNH387_FW_PATH
	depends on SDIO_MARVELL_NH387_WIFI
	string "MRVLNH387 Firmware path"
	default "mrvl/sd8787_uapsta.bin"
	---help---
	  Path to the firmware file.
config MRVLNH387_W1_FW_PATH
	depends on SDIO_MARVELL_NH387_WIFI
	string "MRVLNH387 Firmware path"
	default "mrvl/sd8787_uapsta_w1"
	---help---
	  Path to firmware file.
config MRVLNH387_DEBUG
	depends on SDIO_MARVELL_NH387_WIFI
	string "MRVLNH387 Debug level n/1/2"
	default "n"
		---help---
	  MRVLNH387 Debug level n/1/2.
config MRVLNH387_PROC_DEBUG
	depends on SDIO_MARVELL_NH387_WIFI
	bool "MRVLNH387 Proc debug file"
	default n
		---help---
	  MRVLNH387 Proc debug file.
config MRVLNH387_STA_SUPPORT
	depends on SDIO_MARVELL_NH387_WIFI
	bool "ENABLE STA mode support"
	default y
		---help---
	  ENABLE STA mode support.
config MRVLNH387_UAP_SUPPORT
	depends on SDIO_MARVELL_NH387_WIFI
	bool "Enable AP mode support"
	default y
		---help---
	  Enable AP mode support.
config MRVLNH387_REASSOCIATION
	depends on SDIO_MARVELL_NH387_WIFI
	bool "Re-association in driver"
	default y
		---help---
	  Re-association in driver.
config MRVLNH387_MFG_CMD_SUPPORT
	depends on SDIO_MARVELL_NH387_WIFI
	bool "Manufacturing firmware support"
	default y
		---help---
	  Manufacturing firmware support.
config MRVLNH387_BIG_ENDIAN
	depends on SDIO_MARVELL_NH387_WIFI
	bool "Big-endian platform"
	default n
		---help---
	  Big-endian platform.
config MRVLNH387_SDIO_MULTI_PORT_TX_AGGR
	depends on SDIO_MARVELL_NH387_WIFI
	bool "Enable SDIO multi-port Tx aggregation"
	default n
		---help---
	  Enable SDIO multi-port Tx aggregation.
config MRVLNH387_SDIO_MULTI_PORT_RX_AGGR
	depends on SDIO_MARVELL_NH387_WIFI
	bool "Enable SDIO multi-port Rx aggregation"
	default n
		---help---
	  Enable SDIO multi-port Rx aggregation.
config MRVLNH387_SDIO_SUSPEND_RESUME
	depends on SDIO_MARVELL_NH387_WIFI
	bool "SDIO suspend/resume"
	default n
		---help---
	  SDIO suspend/resume.
endif

config SDIO_TI_WIFI_WGT7310
	tristate "Ti wgt7310 wireless cards support"
	default m
	depends on SD_MMC
	select WIRELESS_EXT
	select WEXT_PRIV
	---help---
	  This module adds support for wireless adapters based on
	  Ti wgt7310 chipset.

          & assure to set these config in 
	  Device Drivers  ---> Generic Driver Options  ---> 
   
endmenu
```

## kernel/drivers/i2c/chips/Kconfig
```kconfig
#
# Miscellaneous I2C chip drivers configuration
#
# *** DEPRECATED! Do not add new entries! See Makefile ***
#

menu "Miscellaneous I2C Chip support"

config SENSORS_MXC622X
	tristate "MEMSIC Accelerometer Sensor MXC622X Driver Support"
	depends on I2C
	help
	  If you say yes here you get support for the MEMSIC accelerometer sensor

config SENSORS_MMC31XX
	tristate "MEMSIC Magnetic Sensor MMC31XX Driver Support"
	depends on I2C
	help
	  If you say yes here you get support for the MEMSIC magnateic sensor

config ECOMPASS
	tristate "MEMSIC eCompass Driver Support"
	depends on I2C
	help
	  If you say yes here you get support for the MEMSIC eCompass

endmenu
```
